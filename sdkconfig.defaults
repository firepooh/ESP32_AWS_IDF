## sdkconfig.defaults
```kconfig
# newlib for ESP32 and ESP8266 platform

CONFIG_NEWLIB_ENABLE=y
CONFIG_NEWLIB_LIBRARY_LEVEL_NORMAL=y
CONFIG_NEWLIB_NANO_FORMAT=
CONFIG_SSL_USING_MBEDTLS=y
CONFIG_LWIP_IPV6=y
CONFIG_PARTITION_TABLE_CUSTOM=y
CONFIG_PARTITION_TABLE_CUSTOM_FILENAME="partitions.csv"
CONFIG_PARTITION_TABLE_FILENAME="partitions.csv"

CONFIG_LWIP_DHCP_GET_NTP_SRV=y
CONFIG_LOG_TIMESTAMP_SOURCE_SYSTEM=y
#CONFIG_EXAMPLE_WIFI_SSID="ALTIWLAN"
#CONFIG_EXAMPLE_WIFI_PASSWORD="20077771ff"
CONFIG_EXAMPLE_WIFI_SSID="TwinsMesh"
CONFIG_EXAMPLE_WIFI_PASSWORD="01020114473"

CONFIG_MQTT_CLIENT_IDENTIFIER="test"
CONFIG_MQTT_BROKER_ENDPOINT="ajwyncrxuu7ba-ats.iot.us-west-2.amazonaws.com"
```
